## meta-lumen/conf/layer.conf
```bitbake
# meta-lumen/conf/layer.conf

BBPATH .= ":${LAYERDIR}"
BBFILES += "${LAYERDIR}/recipes-*/*/*.bb \
             ${LAYERDIR}/recipes-*/*/*.bbappend"

BBFILE_COLLECTIONS += "meta-lumen"
BBFILE_PATTERN_meta-lumen := "^${LAYERDIR}/"
BBFILE_PRIORITY_meta-lumen = "10"

LAYERDEPENDS_meta-lumen = "core tegra"
LAYERSERIES_COMPAT_meta-lumen = "scarthgap"
```
